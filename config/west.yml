## config/west.yml
```yaml
manifest:
  defaults:
    revision: v0.3
  remotes:
    - name: zmkfirmware
      url-base: https://github.com/zmkfirmware

  projects:
    - name: zmk
      remote: zmkfirmware
      import: app/west.yml

    - name: nice-view
      remote: zmkfirmware
      path: modules/nice-view
      revision: main

  self:
    path: config
```
